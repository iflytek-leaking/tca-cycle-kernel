## kernel_ums9620_se50/Documentation/devicetree/bindings/arm/vendor,sysctrl.txt
```
VENDOR sysctrl Registers

Registers for 'vendor,zx296702' SoC:

System management required properties:
      - compatible = "vendor,sysctrl"

Low power management required properties:
      - compatible = "vendor,zx296702-pcu"

Bus matrix required properties:
      - compatible = "vendor,zx-bus-matrix"


Registers for 'vendor,zx296718' SoC:

System management required properties:
      - compatible = "vendor,zx296718-aon-sysctrl"
      - compatible = "vendor,zx296718-sysctrl"

Example:
aon_sysctrl: aon-sysctrl@116000 {
	compatible = "vendor,zx296718-aon-sysctrl", "syscon";
	reg = <0x116000 0x1000>;
};

sysctrl: sysctrl@1463000 {
	compatible = "vendor,zx296718-sysctrl", "syscon";
	reg = <0x1463000 0x1000>;
};
```

## kernel_ums9620_se50/Documentation/devicetree/bindings/arm/vendor.yaml
```yaml
# SPDX-License-Identifier: GPL-2.0
%YAML 1.2
---
$id: http://devicetree.org/schemas/arm/vendor.yaml#
$schema: http://devicetree.org/meta-schemas/core.yaml#

title: VENDOR platforms device tree bindings

maintainers:
  - Jun Nie <jun.nie@linaro.org>

properties:
  $nodename:
    const: '/'
  compatible:
    oneOf:
      - items:
          - enum:
              - vendor,zx296702-ad1
          - const: vendor,zx296702
      - items:
          - enum:
              - vendor,zx296718-evb
          - const: vendor,zx296718

...
```

## kernel_ums9620_se50/Documentation/devicetree/bindings/media/zx-irdec.txt
```
IR Decoder (IRDEC) on VENDOR ZX family SoCs

Required properties:
 - compatible: Should be "vendor,zx296718-irdec".
 - reg: Physical base address and length of IRDEC registers.
 - interrupts: Interrupt number of IRDEC.

Exmaples:

	irdec: ir-decoder@111000 {
		compatible = "vendor,zx296718-irdec";
		reg = <0x111000 0x1000>;
		interrupts = <GIC_SPI 111 IRQ_TYPE_LEVEL_HIGH>;
	};
```

## kernel_ums9620_se50/Documentation/devicetree/bindings/reset/vendor,zx2967-reset.txt
```
VENDOR zx2967 SoCs Reset Controller
=======================================

Please also refer to reset.txt in this directory for common reset
controller binding usage.

Required properties:
- compatible: should be one of the following.
	* vendor,zx296718-reset
- reg: physical base address of the controller and length of memory mapped
	region.
- #reset-cells: must be 1.

example:

	reset: reset-controller@1461060 {
		compatible = "vendor,zx296718-reset";
		reg = <0x01461060 0x8>;
		#reset-cells = <1>;
	};
```

## kernel_ums9620_se50/drivers/power/vendor_supply/Kconfig
```kconfig
# SPDX-License-Identifier: GPL-2.0-only
menuconfig VENDOR_POWER_SUPPLY
	tristate "VENDOR Power supply class support"
	help
	  Say Y here to enable power supply class support. This allows
	  power supply (batteries, AC, USB) monitoring by userspace
	  via sysfs and uevent (if available) and/or APM kernel interface
	  (if selected below).

if VENDOR_POWER_SUPPLY


config VENDOR_POWER_SUPPLY_COMMON
	bool "VENDOR Power supply common"
 	default n
	help
	  Say Y here to enable power supply class.

config VENDOR_POWER_SUPPLY_HWMON
	bool
	prompt "VENDOR Expose power supply sensors as hwmon device"
	depends on HWMON=y || HWMON=POWER_SUPPLY
	default y
	help
	  This options enables API that allows sensors found on a
	  power supply device (current, voltage, temperature) to be
	  exposed as a hwmon device.

	  Say Y here if you want power supplies to
	  have hwmon sysfs interface too.

endif # VENDOR_POWER_SUPPLY
```

## kernel_ums9620_se50/drivers/rekernel_x/Kconfig
```kconfig
config REKERNEL_X
	bool "ReKernel-X: 墓碑（冻结进程）事件上报"
	depends on ANDROID_BINDER_IPC
	default n
	help
	  为墓碑/冻结类模块提供内核支持：冻结进程收到 Binder 调用、关键信号、
	  入站网络包时，通过 Generic Netlink (family "rekernel_x2") 上报用户态。
	  上游: https://github.com/myflavor/ReKernel-X  (原本只支持 >= 5.10)
```

## kernel_ums9620_se50/drivers/tca_fas/Kconfig
```kconfig
# SPDX-License-Identifier: GPL-2.0
config TCA_FAS
	bool "TCA kernel-side Frame Aware Scheduling (FAS)"
	depends on TRACEPOINTS && CPU_FREQ
	default n
	help
	  In-kernel Frame Aware Scheduling.  Hooks the in-tree
	  drm_vblank_event tracepoint, keeps an EMA of the vblank
	  interval and drives a FREQ_QOS_MIN request per CPU cluster
	  so the frame budget (1e9 / target_fps) is met.  This is the
	  same idea as the userspace fas-rs, but it needs no eBPF ring
	  buffer / BTF, so it works on 5.4.

	  Default off.  Knobs at /sys/kernel/tca_fas/.
```

## kernel_ums9620_se50/drivers/vendor/common/crypto_chip/Kconfig
```kconfig
config VENDOR_CRYPTO_CHIP
	bool "VENDOR_CRYPTO_CHIP"
		depends on I2C
		default n
		help
		  Say Y here if you have vendor crypto chip.
		  If unsure, say N.

config VENDOR_CRYPTO_ATSHA204A
	bool "VENDOR_CRYPTO_ATSHA204A"
		depends on I2C
		default n
		help
		  Say Y here if you have crypto atsha204a chip.
		  If unsure, say N.

config VENDOR_CRYPTO_VEB_A5
	tristate "VENDOR_CRYPTO_VEB_A5"
		depends on SPI
		default n
		help
		  Say Y here to build support for crypto veb a5 new.
		  To compile this driver as a module, choose M here.
```

## kernel_ums9620_se50/drivers/vendor/common/leds/aw2016/Kconfig
```kconfig
config VENDOR_LEDS_AW2016
	tristate "VENDOR_LEDS_AW2016"
		depends on I2C
		default n
		help
		  Say Y here if you have crypto breathing light leds chip aw2016.
		  If unsure, say N.
```

## kernel_ums9620_se50/drivers/vendor/common/sensor/Kconfig
```kconfig
config VENDOR_TEMPERATURE_SENSOR
	bool "VENDOR_TEMPERATURE SENSOR"
		depends on I2C
		default n
		help
		  Say Y here if you have vendor temperature sensor.
		  If unsure, say N.

config CUSTOM_KERNEL_SAR_SENSOR
	bool "VENDOR_SAR SENSOR"
		depends on I2C
		default n
		help
		  Say Y here if you have vendor sar sensor.
		  If unsure, say N.

config CUSTOM_KERNEL_SKEY_SENSOR
	bool "VENDOR_SKEY SENSOR"
		depends on I2C
		default n
		help
		  Say Y here if you have vendor sar sensor.
		  If unsure, say N.

source "drivers/vendor/common/sensor/temperature/Kconfig"
source "drivers/vendor/common/sensor/sar/Kconfig"
source "drivers/vendor/common/sensor/skey/Kconfig"
```

## kernel_ums9620_se50/drivers/vendor/common/sqc/Kconfig
```kconfig
menuconfig VENDOR_SQC_CHARGER_V0
	bool "vendor power policy"
	default n
	help
	  Say Y here, if supported vendor sqc charger
```

## kernel_ums9620_se50/drivers/vendor/common/sqc_base/Kconfig
```kconfig
config VENDOR_SQC_CHARGER_VERSION
	string "define vendor sqc charger version"
	help
	This config is to select which vendor sqc_version charger driver you want to use.


config VENDOR_SQC_CHARGER_V7
	bool "vendor power policy"
	default n
	help
	  Say Y here, if supported vendor sqc charger

config VENDOR_SQC_QCOM_QC3PLUS
	bool "Use Qcom QC3+ protocol chip"
	default n
	help
	  Say Y here, if supported vendor sqc qcom QC3+ protocol chip.

config VENDOR_SQC_VENDOR_FG
	bool "Use Qcom QC3+ protocol chip"
	default n
	help
	  Say Y here, if supported vendor sqc qcom QC3+ protocol chip.
```

## kernel_ums9620_se50/drivers/vendor/common/sqc_v2/Kconfig
```kconfig
menuconfig VENDOR_SQC_CHARGER_V2
	bool "sqc power policy"
	default n
	help
	  Say Y here, if supported vendor sqc charger v2
```

## kernel_ums9620_se50/drivers/vendor/common/stats_info/Kconfig
```kconfig
config VENDOR_STATS_INFO
	tristate "VENDOR STATS INFO"
	default n
	help
	  Say 'y' here to include support for vendor stats info.
```

## kernel_ums9620_se50/drivers/vendor/common/vendor_lcdbl/Kconfig
```kconfig
# LCD backlight power ctrl
config VENDOR_LCDBL_I2C_CTRL_VSP_VSN
	tristate "VENDOR LCD backlight power ctrl"

        default n
config VENDOR_LCDBL_I2C_CTRL_VSP_VSN_ENHANCE
        bool "Support for VENDOR vsp vsn power enhance ctrl"
        default n
```

## kernel_ums9620_se50/drivers/vendor/common/zcard_det/Kconfig
```kconfig
# SPDX-License-Identifier: GPL-2.0-only
#
# Misc strange devices
#

config ZCARD_HOLDER
	tristate "vendor card holder test Support"
	help
	  support vendor card holder test.
```

## kernel_ums9620_se50/drivers/vendor/common/zlog/Kconfig
```kconfig
config VENDOR_DEV_MONITOR_SYSTEM
	bool "VENDOR DEVICE MONITOR SYSTEM"
	default n
	help
	  Say Y here, if supported vendor log device monitor system

source "drivers/vendor/common/zlog/zlog_exception/Kconfig"
source "drivers/vendor/common/zlog/zlog_common/Kconfig"
source "drivers/vendor/common/zlog/zlog_test/Kconfig"
```

## kernel_ums9620_se50/drivers/vendor/common/zlog/zlog_common/Kconfig
```kconfig
config VENDOR_LOG_COMMON
	tristate "VENDOR LOG COMMON"
	depends on VENDOR_LOG_EXCEPTION
	default n
	help
	  Say Y here, if supported vendor log common
```

## kernel_ums9620_se50/drivers/vendor/common/zlog/zlog_exception/Kconfig
```kconfig
config VENDOR_LOG_EXCEPTION
	tristate "VENDOR LOG EXCEPTION"
	default n
	help
	  Say Y here, if supported vendor log exception
```

## kernel_ums9620_se50/drivers/vendor/common/zlog/zlog_test/Kconfig
```kconfig
config VENDOR_LOG_E_TEST
	tristate "VENDOR LOG EXCEPTION TEST"
	depends on VENDOR_LOG_EXCEPTION
	depends on VENDOR_LOG_COMMON
	default n
	help
	  Say Y here, if supported vendor log exception
```
